## buildroot/Config.in
```kconfig
source "$BR2_EXTERNAL/package/python-james/Config.in"
source "$BR2_EXTERNAL/package/python-sockjs-tornado/Config.in"
source "$BR2_EXTERNAL/package/rtl-hostapd/Config.in"
source "$BR2_EXTERNAL/package/isc-dhcp/Config.in"
```

## buildroot/configs/rpi_3.10_wlf_defconfig
```kconfig
BR2_arm=y
BR2_arm1176jzf_s=y
BR2_DEFCONFIG="$(CONFIG_DIR)/defconfig"
BR2_OPTIMIZE_2=y
BR2_KERNEL_HEADERS_3_10=y
BR2_TOOLCHAIN_BUILDROOT_GLIBC=y
BR2_EXTRA_GCC_CONFIG_OPTIONS="--with-float=hard"
BR2_TOOLCHAIN_BUILDROOT_CXX=y
BR2_TARGET_OPTIMIZATION="-pipe -mhard-float"
BR2_TARGET_GENERIC_HOSTNAME="deputy"
BR2_TARGET_GENERIC_ISSUE=""
BR2_INIT_SYSTEMD=y
BR2_ROOTFS_SKELETON_CUSTOM=y
BR2_ROOTFS_SKELETON_CUSTOM_PATH="board/raspberrypi/skeleton"
BR2_ROOTFS_OVERLAY="$(BR2_EXTERNAL)/board/rootfs_overlay"
BR2_ROOTFS_POST_BUILD_SCRIPT="$(BR2_EXTERNAL)/board/postscript.sh"
BR2_LINUX_KERNEL=y
BR2_LINUX_KERNEL_CUSTOM_GIT=y
BR2_LINUX_KERNEL_CUSTOM_REPO_URL="https://github.com/raspberrypi/linux.git"
BR2_LINUX_KERNEL_CUSTOM_REPO_VERSION="c43739885d512c92c0aa443b5895b96df5141da0"
BR2_LINUX_KERNEL_PATCH="$(BR2_EXTERNAL)/board/rpi_wlf_3.10_beta/*"
BR2_LINUX_KERNEL_DEFCONFIG="rpi_wolfson_sound_pi"
BR2_LINUX_KERNEL_ZIMAGE=y
BR2_PACKAGE_BUSYBOX_CONFIG="$(BR2_EXTERNAL)/configs/busybox.config"
BR2_PACKAGE_ALSA_UTILS=y
BR2_PACKAGE_ALSA_UTILS_AMIXER=y
BR2_PACKAGE_ALSA_UTILS_APLAY=y
BR2_PACKAGE_FLAC=y
BR2_PACKAGE_JACK2=y
BR2_PACKAGE_BZIP2=y
BR2_PACKAGE_PYTHON=y
BR2_PACKAGE_PYTHON_SSL=y
BR2_PACKAGE_PYTHON_SQLITE=y
BR2_PACKAGE_PYTHON_ZLIB=y
BR2_PACKAGE_PYTHON_PYZMQ=y
BR2_PACKAGE_PYTHON_TORNADO=y
BR2_PACKAGE_CPPZMQ=y
BR2_PACKAGE_BOOST=y
BR2_PACKAGE_BOOST_PROGRAM_OPTIONS=y
BR2_PACKAGE_BOOST_SYSTEM=y
BR2_PACKAGE_BOOST_THREAD=y
BR2_PACKAGE_AVAHI=y
BR2_PACKAGE_AVAHI_DAEMON=y
BR2_PACKAGE_DHCPCD=y
BR2_PACKAGE_DROPBEAR=y
BR2_PACKAGE_HOSTAPD=y
BR2_PACKAGE_LIGHTTPD=y
BR2_PACKAGE_LIGHTTPD_OPENSSL=y
BR2_PACKAGE_LIGHTTPD_ZLIB=y
BR2_PACKAGE_LIGHTTPD_WEBDAV=y
BR2_PACKAGE_SCREEN=y
BR2_PACKAGE_SUDO=y
BR2_PACKAGE_NANO=y
BR2_PACKAGE_RPI_USERLAND=y
BR2_TARGET_RPI_FIRMWARE=y
BR2_PACKAGE_PYTHON_JAMES=y
BR2_PACKAGE_PYTHON_SOCKJS_TORNADO=y
BR2_PACKAGE_RTL_HOSTAPD=y
```

## buildroot/package/python-james/Config.in
```kconfig
config BR2_PACKAGE_PYTHON_JAMES
	bool "python-james"
	depends on BR2_PACKAGE_PYTHON
	help
    James is the recording core and web interface
```

## buildroot/package/python-sockjs-tornado/Config.in
```kconfig
config BR2_PACKAGE_PYTHON_SOCKJS_TORNADO
	bool "python-sockjs-tornado"
	depends on BR2_PACKAGE_PYTHON
	help
    SockJS-tornado is a Python server side counterpart of SockJS-client browser library running on top of Tornado framework.
```
